## app_move/build/Kconfig/Kconfig.modules
```kconfig
menu "healthypi5_zephyr (/Users/akw/Documents/GitHub/my_workspace/healthypi5_zephyr)"
osource "/Users/akw/Documents/GitHub/my_workspace/healthypi5_zephyr/Kconfig"
config ZEPHYR_HEALTHYPI5_ZEPHYR_MODULE
	bool
	default y
endmenu
menu "cmsis (/Users/akw/Documents/GitHub/my_workspace/modules/hal/cmsis)"
osource "$(ZEPHYR_CMSIS_KCONFIG)"
config ZEPHYR_CMSIS_MODULE
	bool
	default y
endmenu
menu "fatfs (/Users/akw/Documents/GitHub/my_workspace/modules/fs/fatfs)"
osource "$(ZEPHYR_FATFS_KCONFIG)"
config ZEPHYR_FATFS_MODULE
	bool
	default y
endmenu
menu "hal_nordic (/Users/akw/Documents/GitHub/my_workspace/modules/hal/nordic)"
osource "$(ZEPHYR_HAL_NORDIC_KCONFIG)"
config ZEPHYR_HAL_NORDIC_MODULE
	bool
	default y
endmenu
menu "hal_rpi_pico (/Users/akw/Documents/GitHub/my_workspace/modules/hal/rpi_pico)"
osource "$(ZEPHYR_HAL_RPI_PICO_KCONFIG)"
config ZEPHYR_HAL_RPI_PICO_MODULE
	bool
	default y
endmenu
menu "littlefs (/Users/akw/Documents/GitHub/my_workspace/modules/fs/littlefs)"
osource "$(ZEPHYR_LITTLEFS_KCONFIG)"
config ZEPHYR_LITTLEFS_MODULE
	bool
	default y
endmenu
menu "lvgl (/Users/akw/Documents/GitHub/my_workspace/modules/lib/gui/lvgl)"
osource "/Users/akw/Documents/GitHub/my_workspace/modules/lib/gui/lvgl/Kconfig"
config ZEPHYR_LVGL_MODULE
	bool
	default y
endmenu
menu "zcbor (/Users/akw/Documents/GitHub/my_workspace/modules/lib/zcbor)"
osource "$(ZEPHYR_ZCBOR_KCONFIG)"
config ZEPHYR_ZCBOR_MODULE
	bool
	default y
endmenu
```

## app_move/build/Kconfig/Kconfig.shield.defconfig
```kconfig
osource "/Users/akw/Documents/GitHub/my_workspace/healthypi5_zephyr/boards/shields/*/Kconfig.defconfig"
osource "/Users/akw/Documents/GitHub/my_workspace/healthypi5_zephyr/boards/shields/*/Kconfig.defconfig"
```

## boards/arm/healthypi5_rp2040/Kconfig.board
```kconfig
# Copyright (c) 2021 Yonatan Schachter
# SPDX-License-Identifier: Apache-2.0

config BOARD_HEALTHYPI5_RP2040
	bool "HealthyPi 5 RP2040"
	depends on SOC_RP2040
```

## boards/healthypi5_esp32c3/board.yml
```yaml
board:
  name: healthypi5_esp32c3
  vendor: protocentral
  socs:
  - name: esp32c3
```

## boards/protocentral/healthypi5/Kconfig
```kconfig
# Copyright (c) 2021 Yonatan Schachter
# SPDX-License-Identifier: Apache-2.0

config BOARD_HEALTHYPI5
	select RP2_FLASH_W25Q080
```

## boards/protocentral/healthypi5/Kconfig.healthypi5
```kconfig
# Copyright (c) 2021 Yonatan Schachter
# SPDX-License-Identifier: Apache-2.0

config BOARD_HEALTHYPI5
	select SOC_RP2040
```

## boards/protocentral/healthypi5/board.yml
```yaml
board:
  name: healthypi5
  full_name: HealthyPi 5
  vendor: protocentral
  socs:
  - name: rp2040
```

## boards/protocentral/healthypi5_esp32c3/board.yml
```yaml
board:
  name: healthypi5_esp32c3
  full_name: HealthyPi 5 ESP32-C3
  vendor: protocentral
  socs:
  - name: esp32c3
```

## boards/protocentral/healthypi_5/Kconfig.defconfig
```kconfig
# Copyright (c) 2021 Yonatan Schachter
# SPDX-License-Identifier: Apache-2.0

if BOARD_HEALTHYPI5_RP2040

config BOARD
	default "healthypi5_rp2040"

config RP2_FLASH_W25Q080
	default y

if I2C_DW

config I2C_DW_CLOCK_SPEED
	default 100

endif #I2C_DW

endif # BOARD_HEALTHYPI5_RP2040
```

## boards/riscv/healthypi5_esp32c3/Kconfig.board
```kconfig
# ESP32C3 devkitm board configuration

# Copyright (c) 2021 Espressif Systems (Shanghai) Co., Ltd.
# SPDX-License-Identifier: Apache-2.0

config BOARD_HEALTHYPI5_ESP32C3
	bool "HealthyPi 5 ESP32C3 Co-processor"
	depends on SOC_SERIES_ESP32C3

choice SOC_PART_NUMBER
	default SOC_ESP32C3_MINI_N4
endchoice
```

## boards/riscv/healthypi5_esp32c3/Kconfig.defconfig
```kconfig
# ESP32C3 devkitm board configuration

# Copyright (c) 2021 Espressif Systems (Shanghai) Co., Ltd.
# SPDX-License-Identifier: Apache-2.0

config BOARD
	default "healthypi5_esp32c3"
	depends on BOARD_HEALTHYPI5_ESP32C3

config HEAP_MEM_POOL_SIZE
	default 98304 if WIFI
	default 40960 if BT
	default 4096

choice BT_HCI_BUS_TYPE
	default BT_ESP32 if BT
endchoice
```

## boards/riscv/healthypi5_esp32c3/healthypi5_esp32c3_defconfig
```kconfig
# SPDX-License-Identifier: Apache-2.0

CONFIG_BOARD_HEALTHYPI5_ESP32C3=y
CONFIG_SOC_ESP32C3=y

CONFIG_MAIN_STACK_SIZE=2048

CONFIG_CONSOLE=y
CONFIG_SERIAL=y
CONFIG_UART_CONSOLE=y
CONFIG_GPIO=y
```

## drivers/sensor/Kconfig
```kconfig
# SPDX-License-Identifier: Apache-2.0

if SENSOR
rsource "max30001/Kconfig"
rsource "max30205/Kconfig"
rsource "afe4400/Kconfig"
endif # SENSOR
```

## drivers/sensor/afe4400/Kconfig
```kconfig
# Configuration options

config SENSOR_AFE4400
	bool "AFE4400 Driver"
	default y
	select SPI
	help
	  Enable the driver for the TI AFE4400 PPG front-end

if SENSOR_AFE4400

config SENSOR_AFE4400_INIT_PRIORITY
	int "Init priority"
	default 80
	help
	  AFE4400 device driver initialization priority.

endif # SENSOR_AFE4400
```

## dts/bindings/sensor/maxim,max30001.yaml
```yaml
# ProtoCentral Electronics (info@protocentral.com)
# SPDX-License-Identifier: Apache-2.0

description: MAX30001 SPI Device

compatible: "maxim,max30001"

include: [sensor-device.yaml, spi-device.yaml]
```

## west.yml
```yaml
# Copyright (c) 2021 Nordic Semiconductor ASA
# SPDX-License-Identifier: Apache-2.0

manifest:
  self:
    west-commands: scripts/west-commands.yml

  remotes:
    - name: zephyrproject-rtos
      url-base: https://github.com/Protocentral/zephyr-healthypi5
    - name: protocentral
      url-base: https://github.com/Protocentral

  projects:
    - name: zephyr-healthypi5
      remote: protocentral
      revision: v3.7-branch
      import: 
        # By using name-allowlist we can clone only the modules that are
        # strictly needed by the application.
        name-allowlist:
          - cmsis-dsp
          - cmsis      # required by the ARM port
          - hal_rpi_pico # required by the RPi Pico port
          - littlefs
          - lvgl      
          - mcuboot
          - zcbor  
          - tinycrypt
          - fatfs
          - libmetal
          - mbedtls
          - liblc3
          - net-tools
          - picolibc
          - hal_espressif
          
#    - name: max30001
#      repo-path: protocentral_max30001_zephyr_driver
#      remote: protocentral
#      revision: main
#      path: drivers/sensor/max30001
```
