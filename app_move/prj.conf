## CMakeLists.txt
```
#-------------------------------------------------------------------------------
# Zephyr Example Application
#
# Copyright (c) 2021 Nordic Semiconductor ASA
# SPDX-License-Identifier: Apache-2.0

cmake_minimum_required(VERSION 3.13.1)
find_package(Zephyr REQUIRED HINTS $ENV{ZEPHYR_BASE})

project(app LANGUAGES C)

FILE(GLOB app_sources src/*.c src/images/*.c)
target_sources(app PRIVATE ${app_sources})

# Add display module only if enabled
#FILE(GLOB display_sources src/display/*.c src/images/*.c)
#target_sources_ifdef(CONFIG_HEALTHYPI_DISPLAY_ENABLED app PRIVATE ${display_sources})

#FILE(GLOB bt_sources src/bt/*.c)
#target_sources_ifdef(CONFIG_BT app PRIVATE ${bt_sources})

zephyr_include_directories(src)
#zephyr_include_directories(src/display)
#zephyr_include_directories(src/bt)
```

## Kconfig
```
mainmenu "HealthyPi 5 Project Configuration"

config HEALTHYPI_USB_CDC_ENABLED
    bool "Enable USB CDC"
    default n
    help
      Enable USB CDC

config HEALTHYPI_DISPLAY_ENABLED
    bool "Enable Display"
    default n
    help
      Enable Display

config HEALTHYPI_USB_MSC_ENABLED
    bool "Enable USB Mass Storage"
    default n
    help
      Enable USB MSC

source "Kconfig.zephyr"
```

## sample.yaml
```
# This file is provided so that the application can be compiled using Twister,
# the Zephyr testing tool. In this file, multiple combinations can be specified,
# so that you can easily test all of them locally or in CI.
sample:
  description: HealthyPi 5 
  name: healthypi5 
common:
  build_only: true
  integration_platforms:
    - healthypi5_rp2040
tests:
  app.default: {}
  app.debug:
    extra_overlay_confs:
      - debug.conf
```

## prj.conf
```kconfig
# HealthyPi 5 Specific Configuration
CONFIG_HEALTHYPI_USB_CDC_ENABLED=y
CONFIG_HEALTHYPI_USB_MSC_ENABLED=n
CONFIG_HEALTHYPI_DISPLAY_ENABLED=y

CONFIG_BT=y
CONFIG_BT_SMP=y
CONFIG_BT_PERIPHERAL=y
CONFIG_BT_DIS=y
CONFIG_BT_DIS_PNP=n
CONFIG_BT_BAS=y
CONFIG_BT_HRS=y
CONFIG_BT_DEVICE_NAME="Zephyr Heartrate Sensor"
CONFIG_BT_DEVICE_APPEARANCE=833

# Memory Configuration
CONFIG_HEAP_MEM_POOL_SIZE=32768
CONFIG_SYSTEM_WORKQUEUE_STACK_SIZE=32768
CONFIG_MAIN_STACK_SIZE=32768

# Zephyr OS Configuration
#CONFIG_SMP=y
#CONFIG_MP_MAX_NUM_CPUS=2
CONFIG_SMF=y
CONFIG_EVENTS=y
CONFIG_LOG=y
CONFIG_CBPRINTF_FP_SUPPORT=y

# Peripheral device drivers
CONFIG_SENSOR=y
CONFIG_SENSOR_MAX30001=y
#CONFIG_LSM6DSO_TRIGGER_GLOBAL_THREAD=y
CONFIG_SENSOR_MAX32664=y
CONFIG_SENSOR_MAX30205=y

CONFIG_I2C=y
CONFIG_FUEL_GAUGE=y

CONFIG_GC9A01A=y

CONFIG_ADC=y
CONFIG_LED=y
CONFIG_GPIO=y
CONFIG_SERIAL=y
CONFIG_UART_INTERRUPT_DRIVEN=y
CONFIG_SERIAL=y
CONFIG_CONSOLE=y
CONFIG_UART_CONSOLE=y
CONFIG_UART_LINE_CTRL=y
CONFIG_DISPLAY=y
CONFIG_DISPLAY_LOG_LEVEL_ERR=y
CONFIG_REBOOT=y


# Filesystem & Internal Flash support to store data
CONFIG_FLASH=y
CONFIG_FLASH_MAP=y
CONFIG_FLASH_PAGE_LAYOUT=y
CONFIG_FILE_SYSTEM=y
CONFIG_FILE_SYSTEM_LITTLEFS=y
CONFIG_MPU_ALLOW_FLASH_WRITE=y

# Enabled settings module and FS to store settings
CONFIG_SETTINGS=y
CONFIG_SETTINGS_RUNTIME=y
CONFIG_SETTINGS_FILE=y
CONFIG_SETTINGS_FILE_PATH="/lfs/settings"

# LVGL Library Options
CONFIG_LVGL=y
CONFIG_LV_COLOR_16_SWAP=y
CONFIG_LV_THEME_DEFAULT_DARK=y
CONFIG_LV_MEM_CUSTOM=y
CONFIG_LV_USE_LOG=y
CONFIG_LV_USE_LABEL=y
CONFIG_LV_USE_BTN=y
CONFIG_LV_USE_IMG=y
#CONFIG_LV_USE_PERF_MONITOR=y

CONFIG_LV_Z_MEM_POOL_SYS_HEAP=y
CONFIG_LV_Z_MEM_POOL_SIZE=16384

# LVGL New Settings
#CONFIG_LV_Z_VDB_SIZE=10
#CONFIG_LV_MEM_BUF_MAX_NUM=256
#CONFIG_LV_Z_MEM_POOL_SYS_HEAP=y
#CONFIG_LV_Z_MEM_POOL_SIZE=32768
CONFIG_LV_Z_VDB_ALIGN=4
#CONFIG_LV_Z_BUFFER_ALLOC_STATIC=y

#CONFIG_LV_Z_MEM_POOL_NUMBER_BLOCKS=16
#CONFIG_LV_Z_VDB_SIZE=20
#CONFIG_SPEED_OPTIMIZATIONS=y
#CONFIG_LV_DISP_DEF_REFR_PERIOD=150

# LVGL Font Options
CONFIG_LV_FONT_MONTSERRAT_12=y
CONFIG_LV_FONT_MONTSERRAT_14=y
CONFIG_LV_FONT_MONTSERRAT_16=y
CONFIG_LV_FONT_MONTSERRAT_20=y
CONFIG_LV_FONT_MONTSERRAT_24=y
CONFIG_LV_FONT_MONTSERRAT_28=y
CONFIG_LV_FONT_MONTSERRAT_34=y
CONFIG_LV_FONT_MONTSERRAT_42=y
CONFIG_LV_FONT_MONTSERRAT_12_SUBPX=y
CONFIG_LV_CIRCLE_CACHE_SIZE=8
CONFIG_LV_FONT_DEFAULT_MONTSERRAT_12=y
CONFIG_LV_USE_FONT_SUBPX=y

# USB Configuration
CONFIG_USB_DEVICE_STACK=y
CONFIG_USB_DEVICE_PRODUCT="HealthyPi 5"
CONFIG_USB_DEVICE_PID=0x0001
CONFIG_USB_DEVICE_VID=4440
CONFIG_USB_DEVICE_INITIALIZE_AT_BOOT=n
CONFIG_USB_DRIVER_LOG_LEVEL_ERR=y
CONFIG_USB_DEVICE_LOG_LEVEL_ERR=y

CONFIG_CONSOLE=y

#CONFIG_BOARD_ENABLE_CPUNET=y

# Ensure an MCUboot-compatible binary is generated.
#CONFIG_BOOTLOADER_MCUBOOT=y

# Enable MCUmgr and dependencies.
CONFIG_NET_BUF=y
CONFIG_ZCBOR=y
CONFIG_CRC=y
CONFIG_MCUMGR=y
CONFIG_STREAM_FLASH=y
CONFIG_FLASH_MAP=y
#CONFIG_IMG_MANAGER=y

#CONFIG_IMG_ERASE_PROGRESSIVELY=y
#CONFIG_IMG_BLOCK_BUF_SIZE=4096

#CONFIG_MCUMGR_GRP_IMG=y
#CONFIG_MCUMGR_GRP_OS=y
#CONFIG_MCUMGR_GRP_STAT=y

# Enable file system commands
#CONFIG_MCUMGR_GRP_FS=y

# Enable the serial MCUmgr transport.
CONFIG_BASE64=y
#CONFIG_MCUMGR_TRANSPORT_UART=y
CONFIG_CONSOLE=y

CONFIG_TEST_RANDOM_GENERATOR=y

CONFIG_NORDIC_QSPI_NOR=y
CONFIG_NORDIC_QSPI_NOR_FLASH_LAYOUT_PAGE_SIZE=4096
CONFIG_NORDIC_QSPI_NOR_STACK_WRITE_BUFFER_SIZE=16

CONFIG_BOARD_ENABLE_DCDC_APP=y
CONFIG_BOARD_ENABLE_DCDC_NET=y
CONFIG_BOARD_ENABLE_DCDC_HV=y
```

## src/data_module.c
```c
#include <zephyr/kernel.h>
#include <zephyr/logging/log.h>
#include <zephyr/device.h>
#include <zephyr/drivers/sensor.h>
#include <stdio.h>
#include <zephyr/random/rand32.h>

#include "max30001.h"

#include "data_module.h"
#include "hw_module.h"
#include "sampling_module.h"
#include "fs_module.h"

// ProtoCentral data formats
#define CES_CMDIF_PKT_START_1 0x0A
#define CES_CMDIF_PKT_START_2 0xFA
#define CES_CMDIF_TYPE_DATA 0x02
#define CES_CMDIF_PKT_STOP 0x0B
#define DATA_LEN 22

char DataPacket[DATA_LEN];
const char DataPacketFooter[2] = {0, CES_CMDIF_PKT_STOP};
const char DataPacketHeader[5] = {CES_CMDIF_PKT_START_1, CES_CMDIF_PKT_START_2, DATA_LEN, 0, CES_CMDIF_TYPE_DATA};

extern const struct device *const max30001_dev;
extern const struct device *const max32664_dev;

static bool settings_send_usb_enabled = true;
static bool settings_send_ble_enabled = false;
static bool settings_send_rpi_uart_enabled = false;

static bool settings_log_data_enabled = false;//true;
static int settings_data_format = DATA_FMT_PLAIN_TEXT;

extern struct k_msgq q_sample;
extern struct k_msgq q_plot;

#define SAMPLING_FREQ 104 // in Hz.

#define LOG_SAMPLE_RATE_SPS 125 
#define LOG_WRITE_INTERVAL  10  // Write to file every 10 seconds
#define LOG_BUFFER_LENGTH   1250+1 // 125Hz * 10 seconds

struct hpi_sensor_data_t log_buffer[LOG_BUFFER_LENGTH];

uint16_t current_session_log_counter = 0;
uint16_t current_session_log_id = 0;
char session_id_str[5];

void sendData(int32_t ecg_sample, int32_t bioz_sample, int32_t raw_red, int32_t raw_ir, int32_t temp, uint8_t hr,
              uint8_t rr, uint8_t spo2, bool _bioZSkipSample)
{
    DataPacket[0] = ecg_sample;
    DataPacket[1] = ecg_sample >> 8;
    DataPacket[2] = ecg_sample >> 16;
    DataPacket[3] = ecg_sample >> 24;

    DataPacket[4] = bioz_sample;
    DataPacket[5] = bioz_sample >> 8;
    DataPacket[6] = bioz_sample >> 16;
    DataPacket[7] = bioz_sample >> 24;

    if (_bioZSkipSample == false)
    {
        DataPacket[8] = 0x00;
    }
    else
    {
        DataPacket[8] = 0xFF;
    }

    DataPacket[9] = raw_red;
    DataPacket[10] = raw_red >> 8;
    DataPacket[11] = raw_red >> 16;
    DataPacket[12] = raw_red >> 24;

    DataPacket[13] = raw_ir;
    DataPacket[14] = raw_ir >> 8;
    DataPacket[15] = raw_ir >> 16;
    DataPacket[16] = raw_ir >> 24;

    DataPacket[17] = temp;
    DataPacket[18] = temp >> 8;

    DataPacket[19] = spo2;
    DataPacket[20] = rr;
    DataPacket[21] = hr;

    if (settings_send_usb_enabled)
    {
        send_usb_cdc(DataPacketHeader, 5);
        send_usb_cdc(DataPacket, DATA_LEN);
        send_usb_cdc(DataPacketFooter, 2);
    }

    if (settings_send_ble_enabled)
    {
        // cmdif_send_ble_data(DataPacketHeader, 5);
        cmdif_send_ble_data(DataPacket, DATA_LEN);
        // cmdif_send_ble_data(DataPacketFooter, 2);
    }

    if (settings_send_rpi_uart_enabled)
    {
        send_rpi_uart(DataPacketHeader, 5);
        send_rpi_uart(DataPacket, DATA_LEN);
        send_rpi_uart(DataPacketFooter, 2);
    }
}

void send_data_text(int32_t ecg_sample, int32_t bioz_sample, int32_t raw_red)
{
    char data[100];
    float f_ecg_sample = (float)ecg_sample / 1000;
    float f_bioz_sample = (float)bioz_sample / 1000;
    float f_raw_red = (float)raw_red / 1000;

    sprintf(data, "%.3f\t%.3f\t%.3f\r\n", f_ecg_sample, f_bioz_sample, f_raw_red);

    if (settings_send_usb_enabled)
    {
        send_usb_cdc(data, strlen(data));
    }

    if (settings_send_ble_enabled)
    {
        cmdif_send_ble_data(data, strlen(data));
    }
}

void send_data_text_1(int32_t in_sample)
{
    char data[100];
    float f_in_sample = (float)in_sample / 1000;

    sprintf(data, "%.3f\r\n", f_in_sample);
    send_usb_cdc(data, strlen(data));
}

// Start a new session log
void record_init_session_log()
{
    // current_session_log.session_id = 0;
    current_session_log_id = 0;
    // strcpy(current_session_log.session_header, "Session Header");
    for(int i = 0; i < LOG_BUFFER_LENGTH; i++)
    {
        log_buffer[i].ecg_sample = 0;
        log_buffer[i].bioz_sample = 0;
        log_buffer[i].raw_red = 0;
        log_buffer[i].raw_ir = 0;
        log_buffer[i].temp = 0;
        log_buffer[i]._bioZSkipSample = false;
    }

    current_session_log_counter = 0;
    current_session_log_id = (uint16_t) sys_rand32_get(); // Create random session ID

    //printk("Init Session ID %s \n", log_get_current_session_id_str());
}

char *log_get_current_session_id_str(void)
{
    sprintf(session_id_str, "%d", current_session_log_id);
    return session_id_str;
}


// Add a log point to the current session log
void record_session_add_point(int32_t ecg_val, int32_t bioz_val, int32_t raw_ir_val, int32_t raw_red_val, int16_t temp)
{
    

    if((current_session_log_counter-1) < LOG_BUFFER_LENGTH)
    {
        current_session_log_counter++;
    }
    else
    {
        printk("Log Buffer Full at %d \n", k_uptime_get_32());
        record_write_to_file(current_session_log_id, current_session_log_counter, log_buffer);
        current_session_log_counter = 0;
        
    }

    //log_buffer[current_session_log_counter].ecg_sample = time;
    log_buffer[current_session_log_counter].ecg_sample = ecg_val;
    log_buffer[current_session_log_counter].bioz_sample = bioz_val;
    log_buffer[current_session_log_counter].raw_ir = raw_ir_val;
    log_buffer[current_session_log_counter].raw_red = raw_red_val;
    log_buffer[current_session_log_counter].temp = temp;

}

void data_thread(void)
{
    printk("Data Thread starting\n");

    struct hpi_sensor_data_t sensor_sample;

    record_init_session_log();

    for (;;)
    {
        k_msgq_get(&q_sample, &sensor_sample, K_FOREVER);

        // Data is now available in sensor_sample

        // Send, store or process data here



        /***** Send to USB if enabled *****/

        if (settings_send_usb_enabled)
        {
            if (settings_data_format == DATA_FMT_OPENVIEW)
            {
                sendData(sensor_sample.ecg_sample, sensor_sample.bioz_sample, sensor_sample.raw_red, sensor_sample.raw_ir,
                         sensor_sample.temp, 0, 0, 0, sensor_sample._bioZSkipSample);
            }
            else if (settings_data_format == DATA_FMT_PLAIN_TEXT)
            {
                send_data_text(sensor_sample.ecg_sample, sensor_sample.bioz_sample, sensor_sample.raw_red);
                //printk("ECG: %d, BIOZ: %d, RED: %d\n", sensor_sample.ecg_sample, sensor_sample.bioz_sample,
                //       sensor_sample.raw_red);
            }
        }

        k_msgq_put(&q_plot, &sensor_sample, K_NO_WAIT);

        if (settings_log_data_enabled)
        {
            // log_data(sensor_sample.ecg_sample, sensor_sample.bioz_sample, sensor_sample.raw_red, sensor_sample.raw_ir,
            //          sensor_sample.temp, 0, 0, 0, sensor_sample._bioZSkipSample);
            record_session_add_point(sensor_sample.ecg_sample, sensor_sample.bioz_sample, sensor_sample.raw_red,
                                     sensor_sample.raw_ir, sensor_sample.temp);

        }
    }
}

#define DATA_THREAD_STACKSIZE 1024
#define DATA_THREAD_PRIORITY 7

K_THREAD_DEFINE(data_thread_id, DATA_THREAD_STACKSIZE, data_thread, NULL, NULL, NULL, DATA_THREAD_PRIORITY, 0, 1000);
```

## src/display_module.c
```c
#include <zephyr/kernel.h>
#include <zephyr/drivers/spi.h>
#include <zephyr/drivers/dac.h>
#include <zephyr/logging/log.h>
#include <zephyr/device.h>
#include <zephyr/drivers/display.h>
#include <lvgl.h>
#include <stdio.h>
#include <zephyr/smf.h>
#include <app_version.h>

#include "sys_sm_module.h"
#include "hw_module.h"
#include "display_module.h"
#include "sampling_module.h"

#include "sys_sm_module.h"

#define SAMPLE_RATE 125
#define DISP_WINDOW_SIZE 500      // SAMPLE_RATE * 4

lv_obj_t *btn_start_session;
lv_obj_t *btn_return;

// LVGL Common Objects
static lv_indev_drv_t m_keypad_drv;
static lv_indev_t *m_keypad_indev = NULL;
extern uint8_t m_key_pressed;

const struct device *display_dev;

// GUI Charts
static lv_obj_t *chart1;
static lv_obj_t *chart2;
static lv_obj_t *chart3;

static lv_chart_series_t *ser1;
static lv_chart_series_t *ser2;
static lv_chart_series_t *ser3;

// GUI Labels
static lv_obj_t *label_hr;
static lv_obj_t *label_spo2;
static lv_obj_t *label_rr;
static lv_obj_t *label_temp;

// LVGL Screens
lv_obj_t *scr_home;
lv_obj_t *scr_menu;
lv_obj_t *scr_charts_all;
lv_obj_t *scr_charts_single;
lv_obj_t *scr_clock;

lv_obj_t *scr_chart_single;

static lv_style_t style_sub;
static lv_style_t style_hr;
static lv_style_t style_spo2;
static lv_style_t style_rr;
static lv_style_t style_temp;
static lv_style_t style_scr_back;
static lv_style_t style_batt_sym;
static lv_style_t style_h1;
static lv_style_t style_h2;
static lv_style_t style_info;
static lv_style_t style_icon;

static lv_obj_t *roller_session_select;

static lv_obj_t *label_current_mode;
static lv_style_t style_scr_back;

bool chart1_update = true;
bool chart2_update = false;
bool chart3_update = false;

float y1_max = 0;
float y1_min = 10000;

float y2_max = 0;
float y2_min = 10000;

float y3_max = 0;
float y3_min = 10000;

static float gx = 0;

int curr_mode = MODE_STANDBY;

extern struct k_sem sem_hw_inited;
K_SEM_DEFINE(sem_disp_inited, 0, 1);

bool display_inited = false;

static lv_obj_t *label_batt_level;
static lv_obj_t *label_batt_level_val;
static lv_obj_t *label_sym_ble;

enum hpi_sensor_data_type
{
    HPI_SENSOR_DATA_ECG = 0x01,
    HPI_SENSOR_DATA_PPG,
    HPI_SENSOR_DATA_RESP,
    HPI_SENSOR_DATA_TEMP
};

enum hpi_disp_screens
{
    HPI_DISP_SCREEN_HOME = 0x01,
    HPI_DISP_SCR_ECG,
    HPI_DISP_SCR_PPG,
    HPI_DISP_SCR_RESP,
};

K_MSGQ_DEFINE(q_plot, sizeof(struct hpi_sensor_data_t), 100, 1);

void display_init_styles()
{
    // Subscript (Unit) label style
    lv_style_init(&style_sub);
    lv_style_set_text_color(&style_sub, lv_color_white());
    lv_style_set_text_font(&style_sub, &lv_font_montserrat_16);

    // HR Number label style
    lv_style_init(&style_hr);
    lv_style_set_text_color(&style_hr, lv_palette_main(LV_PALETTE_RED));
    lv_style_set_text_font(&style_hr, &lv_font_montserrat_42);

    // SpO2 label style
    lv_style_init(&style_spo2);
    lv_style_set_text_color(&style_spo2, lv_palette_main(LV_PALETTE_YELLOW));
    lv_style_set_text_font(&style_spo2, &lv_font_montserrat_42);

    // RR label style
    lv_style_init(&style_rr);
    lv_style_set_text_color(&style_rr, lv_palette_main(LV_PALETTE_BLUE));
    lv_style_set_text_font(&style_rr, &lv_font_montserrat_42);

    // Temp label style
    lv_style_init(&style_temp);
    lv_style_set_text_color(&style_temp, lv_palette_main(LV_PALETTE_LIME));
    lv_style_set_text_font(&style_temp, &lv_font_montserrat_24);

    // Icon welcome screen style
    lv_style_init(&style_icon);
    lv_style_set_text_color(&style_icon, lv_palette_main(LV_PALETTE_YELLOW));
    lv_style_set_text_font(&style_icon, &lv_font_montserrat_42);

    // H1 welcome screen style
    lv_style_init(&style_h1);
    lv_style_set_text_color(&style_h1, lv_color_white());
    lv_style_set_text_font(&style_h1, &lv_font_montserrat_34);

    // H2 welcome screen style
    lv_style_init(&style_h2);
    lv_style_set_text_color(&style_h2, lv_palette_main(LV_PALETTE_ORANGE));
    lv_style_set_text_font(&style_h2, &lv_font_montserrat_28);

    // Info welcome screen style
    lv_style_init(&style_info);
    lv_style_set_text_color(&style_info, lv_color_white());
    lv_style_set_text_font(&style_info, &lv_font_montserrat_16);

    // Screen background style
    lv_style_init(&style_scr_back);
    // lv_style_set_radius(&style, 5);

    /*Make a gradient*/
    lv_style_set_bg_opa(&style_scr_back, LV_OPA_COVER);
    lv_style_set_border_width(&style_scr_back, 0);

    static lv_grad_dsc_t grad;
    grad.dir = LV_GRAD_DIR_HOR;
    grad.stops_count = 2;
    grad.stops[0].color = lv_color_hex(0x003a57); // lv_palette_lighten(LV_PALETTE_GREY, 1);
    grad.stops[1].color = lv_color_black();       // lv_palette_main(LV_PALETTE_BLUE);

    /*Shift the gradient to the bottom*/
    grad.stops[0].frac = 128;
    grad.stops[1].frac = 192;

    //lv_style_set_bg_color(&style_scr_back, lv_color_black());
    lv_style_set_bg_grad(&style_scr_back, &grad);
}
static void keypad_read(lv_indev_drv_t *drv, lv_indev_data_t *data)
{
    static int call_count = 0;

    switch (m_key_pressed)
    {
    case GPIO_KEYPAD_KEY_OK:
        printk("K OK");
        data->key = LV_KEY_ENTER;
        break;
    case GPIO_KEYPAD_KEY_UP:
        printk("K UP");
        data->key = LV_KEY_UP;
        break;
    case GPIO_KEYPAD_KEY_DOWN:
        printk("K DOWN");
        data->key = LV_KEY_DOWN;
        break;
    default:
        break;
    }

    /* key press */
    if (m_key_pressed != GPIO_KEYPAD_KEY_NONE)
    {
        if (call_count == 0)
        {
            data->state = LV_INDEV_STATE_PR;
            call_count = 1;
        }
        else if (call_count == 1)
        {
            call_count = 2;
            data->state = LV_INDEV_STATE_REL;
        }
    }

    /* reset the keys */
    if ((m_key_pressed != GPIO_KEYPAD_KEY_NONE))
    {
        call_count = 0;
        m_key_pressed = GPIO_KEYPAD_KEY_NONE;
        // m_press_type = UNKNOWN;
    }
}

void menu_roller_event_handler(lv_event_t *e)
{
    lv_event_code_t code = lv_event_get_code(e);
    lv_obj_t *roller = lv_event_get_target(e);
    if (code == LV_EVENT_VALUE_CHANGED)
    {
        uint16_t sel = lv_roller_get_selected(roller);
        printk("Roller changed: %d\n", sel);
        switch (sel)
        {
        
            break;
        }

        // display_load_session_preview(sel);
    }
}

void menu_roller_remove_event(void)
{
    lv_obj_remove_event_cb(roller_session_select, menu_roller_event_handler);
}

void draw_header(lv_obj_t *parent, bool showFWVersion)
{
    static lv_style_t style;
    lv_style_init(&style);
    lv_style_set_bg_color(&style, lv_color_black());
    lv_style_set_text_color(&style, lv_color_white());
    lv_style_set_border_width(&style, 0);
    lv_style_set_pad_all(&style, 0);
    lv_obj_add_style(parent, &style, 0);

    // Draw Header bar
    // ProtoCentral logo
    LV_IMG_DECLARE(logo_oneline);
    lv_obj_t *img1 = lv_img_create(parent);
    lv_img_set_src(img1, &logo_oneline);
    lv_obj_align(img1, LV_ALIGN_TOP_MID, 0, 7);
    lv_obj_set_size(img1, 104, 10);
    
    if (showFWVersion)
    {
        // HealthyPi label
        lv_obj_t *label_hpi = lv_label_create(parent);
        char fw_version[40];
        sprintf(fw_version, " HealthyPi 5 (FW v%d.%d.%d Z)", APP_VERSION_MAJOR, APP_VERSION_MINOR, APP_PATCHLEVEL);
        lv_label_set_text(label_hpi, fw_version);
        lv_obj_align(label_hpi, LV_ALIGN_TOP_LEFT, 0, 0);
    }
    // Label for Symbols

    label_batt_level = lv_label_create(parent);
    lv_label_set_text(label_batt_level, LV_SYMBOL_BATTERY_FULL);
    lv_obj_add_style(label_batt_level, &style_batt_sym, LV_STATE_DEFAULT);
    lv_obj_align(label_batt_level, LV_ALIGN_TOP_MID, 15, 25);

    label_batt_level_val = lv_label_create(parent);
    lv_label_set_text(label_batt_level_val, "--%");
    // lv_obj_add_style(label_batt_level, &style_batt_sym, LV_STATE_DEFAULT);
    lv_obj_align_to(label_batt_level_val, label_batt_level, LV_ALIGN_OUT_LEFT_MID, -7, 0);

    label_sym_ble = lv_label_create(parent);
    lv_label_set_text(label_sym_ble, LV_SYMBOL_BLUETOOTH);
    lv_obj_add_style(label_sym_ble, &style_batt_sym, LV_STATE_DEFAULT);
    lv_obj_align_to(label_sym_ble, label_batt_level_val, LV_ALIGN_OUT_LEFT_MID, -5, 0);
}

void hpi_disp_add_samples(int num_samples)
{
    gx += num_samples;
}

void hpi_disp_do_set_scale()
{
    if (gx >= DISP_WINDOW_SIZE)
    {
        if (chart1_update == true)
            lv_chart_set_range(chart1, LV_CHART_AXIS_PRIMARY_Y, y1_min, y1_max);

        gx = 0;
        y1_max = -100000;
        y1_min = 100000;

        y2_max = -100000;
        y2_min = 100000;

        y3_max = -100000;
        y3_min = 100000;
    }
}

void hpi_disp_draw_plotECG(float data_ecg)
{
    if (chart1_update == true)
    {
        if (data_ecg < y1_min)
        {
            y1_min = data_ecg;
        }

        if (data_ecg > y1_max)
        {
            y1_max = data_ecg;
        }

        // printk("E");
        lv_chart_set_next_value(chart1, ser1, data_ecg);
        hpi_disp_add_samples(1);
        hpi_disp_do_set_scale();
    }
}

void hpi_disp_update_temp(int temp)
{
    if (label_temp == NULL)
        return;

    char buf[32];
    double temp_d = (double)(temp / 1000.00);
    sprintf(buf, "%.1f", temp_d);
    lv_label_set_text(label_temp, buf);
}

void hpi_disp_update_batt_level(int batt_level)
{
    if (label_batt_level == NULL)
        return;

    char buf[32];
    sprintf(buf, "%d %% ", batt_level);
    lv_label_set_text(label_batt_level_val, buf);

    if (batt_level > 75)
    {
        lv_label_set_text(label_batt_level, LV_SYMBOL_BATTERY_FULL);
    }
    else if (batt_level > 50)
    {
        lv_label_set_text(label_batt_level, LV_SYMBOL_BATTERY_3);
    }
    else if (batt_level > 25)
    {
        lv_label_set_text(label_batt_level, LV_SYMBOL_BATTERY_2);
    }
    else if (batt_level > 10)
    {
        lv_label_set_text(label_batt_level, LV_SYMBOL_BATTERY_1);
    }
    else
    {
        lv_label_set_text(label_batt_level, LV_SYMBOL_BATTERY_EMPTY);
    }
}

void draw_scr_home(void)
{
    scr_home = lv_obj_create(NULL);

    static lv_style_t style;
    lv_style_init(&style);
    lv_style_set_radius(&style, 1);

    lv_style_set_bg_opa(&style, LV_OPA_COVER);
    lv_style_set_border_width(&style, 0);

    static lv_grad_dsc_t grad;
    grad.dir = LV_GRAD_DIR_HOR;
    grad.stops_count = 2;
    grad.stops[0].color = lv_color_hex(0x003a57); // lv_palette_lighten(LV_PALETTE_GREY, 1);
    grad.stops[1].color = lv_color_black();       // lv_palette_main(LV_PALETTE_BLUE);

    grad.stops[0].frac = 128;
    grad.stops[1].frac = 192;


    lv_style_set_bg_grad(&style, &grad);
    //lv_style_set_bg_color(&style, lv_palette_main(LV_PALETTE_BLUE));

    lv_obj_add_style(scr_home, &style, 0);

    LV_IMG_DECLARE(logo_round_50x50);
    lv_obj_t *img1 = lv_img_create(scr_home);
    lv_img_set_src(img1, &logo_round_50x50);
    lv_obj_align(img1, LV_ALIGN_CENTER, 0, 0);
    lv_obj_set_size(img1, 50, 50);

    lv_obj_t *label_hpi = lv_label_create(scr_home);
    lv_label_set_text(label_hpi, "Welcome to HealthyPi Move");
    //lv_obj_add_style(label_hpi, &style_h1, 0);
    //lv_obj_center(label_hpi);
    lv_obj_align(label_hpi, LV_ALIGN_TOP_MID, 0, 20);


    lv_obj_t *lbl_mode_disp = lv_label_create(scr_home);
    lv_label_set_text(lbl_mode_disp, "Current Mode");
    lv_obj_align(lbl_mode_disp, LV_ALIGN_CENTER, 0, 75);

    label_current_mode = lv_label_create(scr_home);
    lv_label_set_text(label_current_mode, "Standby");
    lv_obj_align(label_current_mode, LV_ALIGN_CENTER, 0, 95);
    lv_obj_add_style(label_current_mode, &style_h2, 0);

    //draw_footer_header(scr_home);

    lv_scr_load_anim(scr_home, LV_SCR_LOAD_ANIM_NONE, 0, 500, true);
}

void draw_scr_chart_single(uint8_t m_data_type)
{
    scr_chart_single = lv_obj_create(NULL);
    draw_header(scr_chart_single, false);

    lv_obj_add_style(scr_chart_single, &style_scr_back, 0);

    // Create Chart 1
    chart1 = lv_chart_create(scr_chart_single);
    lv_obj_set_size(chart1, 220, 100);
    lv_obj_set_style_bg_color(chart1, lv_color_black(), LV_STATE_DEFAULT);

    lv_obj_set_style_size(chart1, 0, LV_PART_INDICATOR);
    lv_chart_set_point_count(chart1, DISP_WINDOW_SIZE);
    // lv_chart_set_type(chart1, LV_CHART_TYPE_LINE);   /*Show lines and points too*
    lv_chart_set_range(chart1, LV_CHART_AXIS_PRIMARY_Y, -1000, 1000);
    // lv_chart_set_range(chart1, LV_CHART_AXIS_SECONDARY_Y, 0, 1000);
    lv_chart_set_div_line_count(chart1, 0, 0);
    lv_chart_set_update_mode(chart1, LV_CHART_UPDATE_MODE_CIRCULAR);

    //lv_obj_set_pos(chart1, 10, 25);
    lv_obj_center(chart1);

    lv_obj_t *label_chart_title = lv_label_create(scr_chart_single);

    if (m_data_type == HPI_SENSOR_DATA_ECG)
        lv_label_set_text(label_chart_title, "Showing ECG");
    else if (m_data_type == HPI_SENSOR_DATA_PPG)
        lv_label_set_text(label_chart_title, "Showing PPG");
    else if (m_data_type == HPI_SENSOR_DATA_RESP)
        lv_label_set_text(label_chart_title, "Showing RESP");
    else if (m_data_type == HPI_SENSOR_DATA_TEMP)
        lv_label_set_text(label_chart_title, "Showing TEMP");

    lv_obj_align_to(label_chart_title, chart1, LV_ALIGN_OUT_BOTTOM_MID, 0, 10);

    // Temp Number label
    label_temp = lv_label_create(scr_chart_single);
    lv_label_set_text(label_temp, "--");
    lv_obj_align_to(label_temp, chart1, LV_ALIGN_OUT_BOTTOM_MID, -25, 45);
    //lv_obj_add_style(label_temp, &style_temp, LV_STATE_DEFAULT);

    // Temp label
    
    /*lv_obj_t *label_temp_title = lv_label_create(scr_chart_single);
    lv_label_set_text(label_temp_title, "Temp: ");
    lv_obj_align_to(label_temp_title, label_temp, LV_ALIGN_OUT_LEFT_MID, 0, 0);
    lv_obj_add_style(label_temp_title, &style_sub, LV_STATE_DEFAULT);
    */

    // Temp Sub deg C label
    lv_obj_t *label_temp_sub = lv_label_create(scr_chart_single);
    lv_label_set_text(label_temp_sub, "°F");
    lv_obj_align_to(label_temp_sub, label_temp, LV_ALIGN_OUT_RIGHT_MID, 20, 0);
    //lv_obj_add_style(label_temp_sub, &style_sub, LV_STATE_DEFAULT);
    // lv_obj_add_style(label_rr_sub, &style_sub, LV_STATE_DEFAULT);

    /* Data Series for main plot*/
    if (m_data_type == HPI_SENSOR_DATA_ECG)
        ser1 = lv_chart_add_series(chart1, lv_palette_main(LV_PALETTE_RED), LV_CHART_AXIS_PRIMARY_Y);
    else if (m_data_type == HPI_SENSOR_DATA_PPG)
        ser1 = lv_chart_add_series(chart1, lv_palette_main(LV_PALETTE_YELLOW), LV_CHART_AXIS_PRIMARY_Y);
    else if (m_data_type == HPI_SENSOR_DATA_RESP)
        ser1 = lv_chart_add_series(chart1, lv_palette_main(LV_PALETTE_BLUE), LV_CHART_AXIS_PRIMARY_Y);
    else if (m_data_type == HPI_SENSOR_DATA_TEMP)
        ser1 = lv_chart_add_series(chart1, lv_palette_main(LV_PALETTE_LIME), LV_CHART_AXIS_PRIMARY_Y);

    lv_scr_load_anim(scr_chart_single, LV_SCR_LOAD_ANIM_OUT_BOTTOM, 100, 0, true);
    // lv_scr_load(scr_chart_single);
}

static lv_obj_t *meter;

static void set_value(void *indic, int32_t v) {
  lv_meter_set_indicator_end_value(meter, (lv_meter_indicator_t *)indic, v);
}

void draw_scr_clockface(void)
{   
    scr_clock = lv_obj_create(NULL);
    meter = lv_meter_create(scr_clock);
    lv_obj_set_size(meter, 220, 220);
    lv_obj_center(meter);
    // lv_obj_set_style_bg_color(meter, LV_COLOR_MAKE(22, 83, 105), LV_STATE_DEFAULT);

    /*Create a scale for the minutes*/
    /*61 ticks in a 360 degrees range (the last and the first line overlaps)*/
    lv_meter_scale_t *scale_min = lv_meter_add_scale(meter);
    lv_meter_set_scale_ticks(meter, scale_min, 61, 1, 10, lv_color_make(22, 83, 105));
    lv_meter_set_scale_range(meter, scale_min, 0, 60, 360, 270);

    /*Create another scale for the hours. It's only visual and contains only major ticks*/
    lv_meter_scale_t *scale_hour = lv_meter_add_scale(meter);
    lv_meter_set_scale_ticks(meter, scale_hour, 12, 0, 0, lv_color_make(22, 83, 105));           /*12 ticks*/
    lv_meter_set_scale_major_ticks(meter, scale_hour, 1, 2, 20, lv_color_make(22, 83, 105), 10); /*Every tick is major*/
    lv_meter_set_scale_range(meter, scale_hour, 1, 12, 330, 300);                                /*[1..12] values in an almost full circle*/

    LV_IMG_DECLARE(img_hand);

    /*Add a the hands from images*/
    lv_meter_indicator_t *indic_min = lv_meter_add_needle_img(meter, scale_min, &img_hand, 5, 5);
    lv_meter_indicator_t *indic_hour = lv_meter_add_needle_img(meter, scale_min, &img_hand, 5, 5);

    /*Create an animation to set the value*/
    lv_anim_t a;
    lv_anim_init(&a);
    lv_anim_set_exec_cb(&a, set_value);
    lv_anim_set_values(&a, 0, 60);
    lv_anim_set_repeat_count(&a, LV_ANIM_REPEAT_INFINITE);
    lv_anim_set_time(&a, 2000); /*2 sec for 1 turn of the minute hand (1 hour)*/
    lv_anim_set_var(&a, indic_min);
    lv_anim_start(&a);

    lv_anim_set_var(&a, indic_hour);
    lv_anim_set_time(&a, 24000); /*24 sec for 1 turn of the hour hand*/
    lv_anim_set_values(&a, 0, 60);
    lv_anim_start(&a);

    // ProtoCentral logo
    LV_IMG_DECLARE(logo_oneline);
    lv_obj_t *img1 = lv_img_create(scr_clock);
    lv_img_set_src(img1, &logo_oneline);
    lv_obj_align_to(img1, meter, LV_ALIGN_CENTER, 0, 30);
    lv_obj_set_size(img1, 150, 10);

    // ProtoCentral round logo
    LV_IMG_DECLARE(logo_round_50x50);
    lv_obj_t *img2 = lv_img_create(scr_clock);
    lv_img_set_src(img2, &logo_round_50x50);
    lv_obj_align_to(img2, meter, LV_ALIGN_CENTER, 0, -30);
    lv_obj_set_size(img2, 50, 50);
}

void display_screens_thread(void)
{
    k_sem_take(&sem_hw_inited, K_FOREVER);

    display_dev = DEVICE_DT_GET(DT_CHOSEN(zephyr_display));
    if (!device_is_ready(display_dev))
    {
        // LOG_ERR("Device not ready, aborting test");
        return;
    }
    // Init all styles globally
    display_init_styles();

    // Setup LVGL Input Device
    lv_indev_drv_init(&m_keypad_drv);
    m_keypad_drv.type = LV_INDEV_TYPE_KEYPAD;
    m_keypad_drv.read_cb = keypad_read;
    m_keypad_indev = lv_indev_drv_register(&m_keypad_drv);

    display_blanking_off(display_dev);

    int ret=display_set_brightness(display_dev,0);
	
    printk("Display screens inited");
    // k_sem_give(&sem_disp_inited);
    //  draw_scr_menu("A\nB\n");
    //draw_scr_home();
    //draw_scr_clockface();

    struct hpi_sensor_data_t sensor_sample;
    //struct hpi_computed_data_t computed_data;
    
    draw_scr_chart_single(HPI_SENSOR_DATA_ECG);
    while (1)

    {
        k_msgq_get(&q_plot, &sensor_sample, K_FOREVER);

        //printk("P");
        
        hpi_disp_draw_plotECG((float)((sensor_sample.ecg_sample) / 1000000.0000));

        lv_task_handler();
        k_sleep(K_MSEC(4));
    }
}

#define DISPLAY_SCREENS_THREAD_STACKSIZE 8192
#define DISPLAY_SCREENS_THREAD_PRIORITY 5

K_THREAD_DEFINE(display_screens_thread_id, DISPLAY_SCREENS_THREAD_STACKSIZE, display_screens_thread, NULL, NULL, NULL, DISPLAY_SCREENS_THREAD_PRIORITY, 0, 0);
```

## src/display_module.h
```c
#define pragma once

void draw_scr_home_menu(void);
void draw_scr_charts_all(void);
void draw_scr_chart_single(uint8_t m_data_type);
void draw_scr_menu(char* session_names);

void draw_plotppg(float data_ppg);
void draw_plotresp(float data_resp);
void draw_plotECG(float data_ecg);

void hpi_disp_update_batt_level(int batt_level);
void hpi_disp_update_temp(int temp);
```

## src/fs_module.c
```c
#include <zephyr/kernel.h>
#include <zephyr/drivers/spi.h>
#include <zephyr/drivers/dac.h>
#include <zephyr/logging/log.h>
#include <zephyr/device.h>
#include <stdio.h>

#include <zephyr/fs/fs.h>
#include <zephyr/fs/littlefs.h>
#include <zephyr/storage/flash_map.h>
#include <zephyr/settings/settings.h>

#include "sys_sm_module.h"
#include "sampling_module.h"

LOG_MODULE_REGISTER(fs_module);

K_SEM_DEFINE(sem_fs_module, 0, 1);

const char fname_sessions[30] = "/lfs/sessions";

#define PARTITION_NODE DT_NODELABEL(lfs1)

#if DT_NODE_EXISTS(PARTITION_NODE)
FS_FSTAB_DECLARE_ENTRY(PARTITION_NODE);
#else  /* PARTITION_NODE */
FS_LITTLEFS_DECLARE_DEFAULT_CONFIG(storage);
static struct fs_mount_t lfs_storage_mnt = {
    .type = FS_LITTLEFS,
    .fs_data = &storage,
    .storage_dev = (void *)FIXED_PARTITION_ID(storage_partition),
    .mnt_point = "/lfs",
};
#endif /* PARTITION_NODE */

struct fs_mount_t *mp =
#if DT_NODE_EXISTS(PARTITION_NODE)
    &FS_FSTAB_ENTRY(PARTITION_NODE)
#else
    &lfs_storage_mnt
#endif
    ;

/* Default values are assigned to settings values consuments
 * All of them will be overwritten if storage contain proper key-values
 */
uint8_t angle_val;
uint64_t length_val = 100;
uint16_t length_1_val = 40;
uint32_t length_2_val = 60;
int32_t voltage_val = -3000;



static int littlefs_flash_erase(unsigned int id)
{
    const struct flash_area *pfa;
    int rc;

    rc = flash_area_open(id, &pfa);
    if (rc < 0)
    {
        LOG_ERR("FAIL: unable to find flash area %u: %d\n",
                id, rc);
        return rc;
    }

    printk("Area %u at 0x%x on %s for %u bytes\n",
           id, (unsigned int)pfa->fa_off, pfa->fa_dev->name,
           (unsigned int)pfa->fa_size);

    /* Optional wipe flash contents */
    if (IS_ENABLED(CONFIG_APP_WIPE_STORAGE))
    {
        rc = flash_area_erase(pfa, 0, pfa->fa_size);
        LOG_ERR("Erasing flash area ... %d", rc);
    }

    flash_area_close(pfa);
    return rc;
}

static int littlefs_mount(struct fs_mount_t *mp)
{
    int rc;

    /*rc = littlefs_flash_erase((uintptr_t)mp->storage_dev);
    if (rc < 0)
    {
        return rc;
    }*/

    rc = fs_mount(mp);
    if (rc < 0)
    {
        printk("FAIL: mount id %" PRIuPTR " at %s: %d\n",
               (uintptr_t)mp->storage_dev, mp->mnt_point, rc);
        return rc;
    }
    printk("%s mount: %d\n", mp->mnt_point, rc);


    return 0;
}

int hpi_settings_handle_set(const char *name, size_t len, settings_read_cb read_cb,
                            void *cb_arg);
int hpi_settings_handle_commit(void);
int hpi_settings(int (*cb)(const char *name,
                           const void *value, size_t val_len));

/* dynamic main tree handler */
struct settings_handler hpi_handler = {
    .name = "hpi",
    .h_get = NULL,
    .h_set = hpi_settings_handle_set,
    .h_commit = hpi_settings_handle_commit,
    .h_export = hpi_settings};

int hpi_settings_handle_set(const char *name, size_t len, settings_read_cb read_cb,
                            void *cb_arg)
{
    const char *next;
    size_t next_len;
    int rc;

    if (settings_name_steq(name, "angle/1", &next) && !next)
    {
        if (len != sizeof(angle_val))
        {
            return -EINVAL;
        }
        rc = read_cb(cb_arg, &angle_val, sizeof(angle_val));
        printk("<hpi/angle/1> = %d\n", angle_val);
        return 0;
    }

    next_len = settings_name_next(name, &next);

    if (!next)
    {
        return -ENOENT;
    }

    if (!strncmp(name, "length", next_len))
    {
        next_len = settings_name_next(name, &next);

        if (!next)
        {
            rc = read_cb(cb_arg, &length_val, sizeof(length_val));
            printk("<hpi/length> = %" PRId64 "\n", length_val);
            return 0;
        }

        if (!strncmp(next, "1", next_len))
        {
            rc = read_cb(cb_arg, &length_1_val,
                         sizeof(length_1_val));
            printk("<hpi/length/1> = %d\n", length_1_val);
            return 0;
        }

        if (!strncmp(next, "2", next_len))
        {
            rc = read_cb(cb_arg, &length_2_val,
                         sizeof(length_2_val));
            printk("<hpi/length/2> = %d\n", length_2_val);
            return 0;
        }

        return -ENOENT;
    }

    return -ENOENT;
}

int hpi_settings_handle_commit(void)
{
    printk("loading all settings is done\n");
    return 0;
}

int hpi_settings(int (*cb)(const char *name,
                           const void *value, size_t val_len))
{
    printk("export keys under <hpi> handler\n");
    (void)cb("hpi/angle/1", &angle_val, sizeof(angle_val));
    (void)cb("hpi/length", &length_val, sizeof(length_val));
    (void)cb("hpi/length/1", &length_1_val, sizeof(length_1_val));
    (void)cb("hpi/length/2", &length_2_val, sizeof(length_2_val));

    return 0;
}

void init_settings()
{
    int rc;

    rc = settings_subsys_init();
    if (rc)
    {
        printk("settings subsys initialization: fail (err %d)\n", rc);
        return;
    }

    rc = settings_register(&hpi_handler);
    if (rc)
    {
        printk("subtree <%s> handler registered: fail (err %d)\n",
               hpi_handler.name, rc);
    }

    // settings_load();

    int32_t val_s32 = 25;
    /* save certain key-value directly*/
    printk("\nsave <hpi/beta/voltage> key directly: ");
    rc = settings_save_one("hpi/beta/voltage", (const void *)&val_s32,
                           sizeof(val_s32));
}

static int lsdir(const char *path)
{
    int res;
    struct fs_dir_t dirp;
    static struct fs_dirent entry;

    fs_dir_t_init(&dirp);

    /* Verify fs_opendir() */
    res = fs_opendir(&dirp, path);
    if (res)
    {
        LOG_ERR("Error opening dir %s [%d]\n", path, res);
        return res;
    }

    LOG_PRINTK("\nListing dir %s ...\n", path);
    for (;;)
    {
        /* Verify fs_readdir() */
        res = fs_readdir(&dirp, &entry);

        /* entry.name[0] == 0 means end-of-dir */
        if (res || entry.name[0] == 0)
        {
            if (res < 0)
            {
                LOG_ERR("Error reading dir [%d]\n", res);
            }
            break;
        }

        if (entry.type == FS_DIR_ENTRY_DIR)
        {
            LOG_PRINTK("[DIR ] %s\n", entry.name);
        }
        else
        {
            LOG_PRINTK("[FILE] %s (size = %zu)\n",
                       entry.name, entry.size);
        }
    }

    /* Verify fs_closedir() */
    fs_closedir(&dirp);

    return res;
}

void record_write_to_file(int current_session_log_id, int current_session_log_counter, struct hpi_sensor_data_t *current_session_log_points)
{
    struct fs_file_t file;
    struct fs_statvfs sbuf;

    fs_file_t_init(&file);

    fs_mkdir("/lfs/log");

    char fname[30] = "/lfs/log/";

    printf("Write to file... %d\n", current_session_log_id);
    char session_id_str[5];
    sprintf(session_id_str, "%d", current_session_log_id);
    strcat(fname, session_id_str);

    printf("Session Length: %d\n", current_session_log_counter);

    int rc = fs_open(&file, fname, FS_O_CREATE | FS_O_RDWR | FS_O_APPEND);
    if (rc < 0)
    {
        printk("FAIL: open %s: %d", fname, rc);
    }
    // Session log header
    // rc=fs_write(&file, &current_session_log_, sizeof(current_session_log_id));

    for (int i = 0; i < current_session_log_counter; i++)
    {
        rc = fs_write(&file, &current_session_log_points[i], sizeof(struct hpi_sensor_data_t));
    }

    rc = fs_close(&file);
    rc = fs_sync(&file);

    rc = fs_statvfs(mp->mnt_point, &sbuf);
    if (rc < 0)
    {
        printk("FAIL: statvfs: %d\n", rc);
        // goto out;
    }
}

void record_wipe_all(void)
{
    int err;
    struct fs_dir_t dir;

    char file_name[100] = "";

    fs_dir_t_init(&dir);

    err = fs_opendir(&dir, "/lfs/log");
    if (err)
    {
        printk("Unable to open (err %d)", err);
    }

    while (1)
    {
        struct fs_dirent entry;

        err = fs_readdir(&dir, &entry);
        if (err)
        {
            printk("Unable to read directory");
            break;
        }

        /* Check for end of directory listing */
        if (entry.name[0] == '\0')
        {
            break;
        }

        // printk("%s%s %d\n", entry.name,
        //	      (entry.type == FS_DIR_ENTRY_DIR) ? "/" : "",entry.size);

        // if (strstr(entry.name, "") != NULL)
        //{
        strcpy(file_name, "/lfs/log/");
        strcat(file_name, entry.name);

        printk("Deleting %s\n", file_name);
        fs_unlink(file_name);
    }

    fs_closedir(&dir);
}

void fs_module_init(void)
{
    int rc;
    struct fs_statvfs sbuf;

    printk("Initing FS...\n");

    rc = littlefs_mount(mp);
    if (rc < 0)
    {
        return;
    }

    /*rc = fs_statvfs(mp->mnt_point, &sbuf);
    if (rc < 0)
    {
        // printk("FAIL: statvfs: %d\n", rc);
        // goto out;
    }

    printk("%s: bsize = %lu ; frsize = %lu ;"
           " blocks = %lu ; bfree = %lu\n",
           mp->mnt_point,
           sbuf.f_bsize, sbuf.f_frsize,
           sbuf.f_blocks, sbuf.f_bfree);
    */
    /*rc = lsdir("/lfs/log");
    if (rc < 0)
    {
        LOG_PRINTK("FAIL: lsdir %s: %d\n", mp->mnt_point, rc);
        // goto out;
    }*/
}
```

## src/fs_module.h
```c
#ifndef fs_module_h
#define fs_module_h

#include "sampling_module.h"

void fs_module_init(void);
void init_settings(void);
void record_write_to_file(int current_session_log_id, int current_session_log_counter, struct hpi_sensor_data_t *current_session_log_points);

#endif
```

## src/hw_module.h
```c
#ifndef hw_module_h
#define hw_module_h

uint32_t hw_keypad_get_key(void);

void set_current(uint16_t current_uA);
uint16_t read_voltage(int channel_no);

void send_usb_cdc(const char *buf, size_t len);

int readADC(void);

enum gpio_keypad_key
{
    GPIO_KEYPAD_KEY_NONE = 0,
    GPIO_KEYPAD_KEY_OK,
    GPIO_KEYPAD_KEY_UP,
    GPIO_KEYPAD_KEY_DOWN,
    GPIO_KEYPAD_KEY_LEFT,
    GPIO_KEYPAD_KEY_RIGHT,
};

#endif
```

## src/sampling_module.c
```c
#include <zephyr/kernel.h>
#include <zephyr/logging/log.h>
#include <zephyr/device.h>
#include <zephyr/drivers/sensor.h>

#include "max30001.h"

#include "sampling_module.h"
#include "sys_sm_module.h"

#include "display_module.h"

extern const struct device *const max30001_dev;
extern const struct device *const max32664_dev;

#define SAMPLING_INTERVAL_MS 8

K_MSGQ_DEFINE(q_sample, sizeof(struct hpi_sensor_data_t), 100, 1);

void sampling_thread(void)
{
    printk("Sampling Thread starting\n");

    for (;;)
    {
        k_sleep(K_MSEC(SAMPLING_INTERVAL_MS));

        /*struct k_timer next_val_timer;
        k_timer_init(&next_val_timer, NULL, NULL);
        k_timer_start(&next_val_timer, K_USEC(time_between_samples_us), K_NO_WAIT);
        */

        struct sensor_value ecg_sample;
        struct sensor_value bioz_sample;

        struct sensor_value red_sample;
        struct sensor_value ir_sample;

#ifdef CONFIG_SENSOR_MAX30001
        sensor_sample_fetch(max30001_dev);
        sensor_channel_get(max30001_dev, SENSOR_CHAN_ECG_UV, &ecg_sample);
        sensor_channel_get(max30001_dev, SENSOR_CHAN_BIOZ_UV, &bioz_sample);
#endif 

/*
#ifdef CONFIG_SENSOR_MAX32664
        sensor_sample_fetch(max32664_dev);
        sensor_channel_get(max32664_dev, SENSOR_CHAN_RED, &red_sample);
        sensor_channel_get(max32664_dev, SENSOR_CHAN_IR, &ir_sample);
        
#endif
*/
        struct hpi_sensor_data_t sensor_sample;

        sensor_sample.ecg_sample = ecg_sample.val1;
        sensor_sample.bioz_sample = bioz_sample.val1;
        sensor_sample.raw_red = 0;//red_sample.val1;
        sensor_sample.raw_ir = 0;//ir_sample.val1;
        sensor_sample.temp = 0;
        sensor_sample._bioZSkipSample = false;

        k_msgq_put(&q_sample, &sensor_sample, K_NO_WAIT);

        // busy loop until next value should be grabbed
        // while (k_timer_status_get(&next_val_timer) <= 0);
    }
}

#define SAMPLING_THREAD_STACKSIZE 2048
#define SAMPLING_THREAD_PRIORITY 7

K_THREAD_DEFINE(sampling_thread_id, SAMPLING_THREAD_STACKSIZE, sampling_thread, NULL, NULL, NULL, SAMPLING_THREAD_PRIORITY, 0, 1000);
```

## src/sampling_module.h
```c
#pragma once

struct hpi_sensor_data_t {
    int32_t ecg_sample;
    int32_t bioz_sample;
    int32_t raw_red;
    int32_t raw_ir;
    int32_t temp;
    bool _bioZSkipSample;
};
```

## src/sys_sm_module.c
```c
#include <zephyr/kernel.h>
#include <zephyr/drivers/spi.h>
#include <zephyr/drivers/dac.h>
#include <zephyr/logging/log.h>
#include <zephyr/device.h>
#include <zephyr/drivers/display.h>
#include <lvgl.h>
#include <stdio.h>
#include <zephyr/smf.h>

#include "hw_module.h"
#include "display_module.h"
#include "fs_module.h"

#include "sys_sm_module.h"

// static int sess_time = 0;

// Display State Machine - SMF
static const struct smf_state display_states[];

extern const struct device *display_dev;

extern struct k_sem sem_disp_inited;

enum display_state
{
    DISPLAY_STATE_HOME,
};

static enum display_state current_state = DISPLAY_STATE_HOME;

/* User defined object */
struct d_object
{
    /* This must be first */
    struct smf_ctx ctx;

    /* Events */
    struct k_event smf_event;
    int32_t events;

    /* Other state specific data add here */
} d_obj;

void switch_state_home()
{
    smf_set_state(SMF_CTX(&d_obj), &display_states[DISPLAY_STATE_HOME]);
}

static void display_state_home_entry(void *o)
{
    // struct d_object *s = (struct d_object *)o;
    printk("SMF State Entry: HOME\n");

    //draw_scr_charts_all();
    //draw_scr_chart_single();
    //draw_scr_home();

    current_state = DISPLAY_STATE_HOME;
}

static void display_state_home_run(void *o)
{
    // struct d_object *s = (struct d_object *)o;
    //  printk("Display SMF State: (RUN) HOME");

    // Code to keep home screen running
}

static void display_state_home_exit(void *o)
{
    // struct d_object *s = (struct d_object *)o;
    printk("SMF State Exit: HOME\n");

    // TODO: Dispose of screen
}

static const struct smf_state display_states[] =
    {
        [DISPLAY_STATE_HOME] = SMF_CREATE_STATE(display_state_home_entry, display_state_home_run, display_state_home_exit),

};

void sys_sm_thread(void)
{
    int ret = 0;

    // display_screens_init();
    //k_sem_take(&sem_disp_inited, K_FOREVER);

    k_event_init(&d_obj.smf_event);

    /* Set initial SMF state */
    smf_set_initial(SMF_CTX(&d_obj), &display_states[DISPLAY_STATE_HOME]);

    printk("Display Thread Started\n");

    while (1)
    {
        /* State machine terminates if a non-zero value is returned */
        ret = smf_run_state(SMF_CTX(&d_obj));
        if (ret)
        {
            /* handle return code and terminate state machine */
            break;
        }

        k_sleep(K_SECONDS(1));
    }
}

#define SYS_SM_THREAD_STACKSIZE 4096
#define SYS_SM_THREAD_PRIORITY 7

K_THREAD_DEFINE(sys_smf_thread_id, SYS_SM_THREAD_STACKSIZE, sys_sm_thread, NULL, NULL, NULL, SYS_SM_THREAD_PRIORITY, 0, 1500);
```
